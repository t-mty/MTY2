## boards/shields/mty_2/Kconfig.defconfig
```kconfig
if SHIELD_MTY_2_RIGHT

config ZMK_KEYBOARD_NAME
    default "mty_2"

endif

if SHIELD_MTY_2_LEFT || SHIELD_MTY_2_RIGHT

config ZMK_SPLIT
    default y

endif

if ZMK_KEYBOARD_YOUR_KEYBOARD

config ZMK_POINTING
    default y

config PAW3222
    default y

endif
```

## boards/shields/mty_2/Kconfig.shield
```kconfig
config SHIELD_MTY_2_LEFT
    def_bool $(shields_list_contains,mty_2_left)
config SHIELD_MTY_2_RIGHT
    def_bool $(shields_list_contains,mty_2_right)
```
